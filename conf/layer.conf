## conf/layer.conf
```bitbake
# We have a conf and classes directory, add to BBPATH
BBPATH .= ":${LAYERDIR}"

# We have recipes-* directories, add to BBFILES
BBFILES += "${LAYERDIR}/recipes-*/*/*.bb \
            ${LAYERDIR}/recipes-*/*/*.bbappend"

# Dynamic layers
BBFILES_DYNAMIC += "\
    virtualization-layer:${LAYERDIR}/dynamic-layers/meta-virtualization/recipes-*/*/*.bbappend \
    meta-edgefarm-core:${LAYERDIR}/dynamic-layers/meta-edgefarm-core/recipes-*/*/*.bbappend \
    meta-edgefarm-core:${LAYERDIR}/dynamic-layers/meta-edgefarm-core/recipes-*/*/*.bb \
"

BBFILE_COLLECTIONS += "meta-ci4rail-bsp"
BBFILE_PATTERN_meta-ci4rail-bsp = "^${LAYERDIR}/"
BBFILE_PRIORITY_meta-ci4rail-bsp = "99"

LAYERSERIES_COMPAT_meta-ci4rail-bsp = "dunfell"
LAYERDEPENDS_meta-ci4rail-bsp = "core \
                                 toradex-nxp-layer \
                                 toradex-bsp-common-layer \
                                 openembedded-layer \
                                 networking-layer \
                                 "
```

## conf/machine/moducop-cpu01.conf
```bitbake
#@TYPE: Machine
#@NAME: Moducop CPU01
#@DESCRIPTION: Moducop CPU01 with Toradex Verdin imx8mm module
#@MAINTAINER: Ci4Rail GmbH <engineering@ci4rail.com>

# keep the original machine as an override with high prio
MACHINEOVERRIDES =. "verdin-imx8mm:"

require conf/machine/verdin-imx8mm.conf

# Remove original image type provided by torradex
IMAGE_CLASSES_remove = "image_type_tezi"
IMAGE_FSTYPES_remove = "teziimg"

KERNEL_DEVICETREE = " \
    freescale/imx8mm-verdin-wifi-moducop-cpu01.dtb \
"
MACHINE_NAME = "Moducop-CPU01"

MACHINE_FEATURES_remove += "screen touchscreen"
```
